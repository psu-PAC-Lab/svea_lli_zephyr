## west-manifest/west.yml
```yaml
manifest:
  remotes:
    - name: zephyrproject
      url-base: https://github.com/zephyrproject-rtos
  projects:
    - name: zephyr
      repo-path: zephyr
      remote: zephyrproject
      revision: v4.1.0
      clone-depth: 1
      import:
        path-prefix: external
        name-allowlist:
          - mcuboot
          - hal_st
          - hal_stm32
          - cmsis
          - hal_tdk
          - segger

  self:
    path: .

# Configure west to find custom boards
build:
  board-root: .
```
